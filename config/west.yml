## config/west.yml
```yaml
manifest:
  remotes:
    - name: zmkfirmware
      url-base: https://github.com/zmkfirmware # ← 公式リポジトリに変更
  projects:
    - name: zmk
      remote: zmkfirmware
      revision: main # ← 最新の安定版である main ブランチに変更
      import: app/west.yml
  self:
    path: config
```
